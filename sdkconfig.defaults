## sdkconfig.defaults
```kconfig
# ZZZ_Elevator

# UART/Serial
CONFIG_ESP_CONSOLE_UART_NUM=0 # main port
CONFIG_ESP_CONSOLE_UART_BAUDRATE=115200 # fuck 9600

# Flash
CONFIG_ESPTOOLPY_FLASHMODE="qio" # quad io shit
CONFIG_ESPTOOLPY_FLASHFREQ_80M=y # double clk shit
CONFIG_ESPTOOLPY_FLASHSIZE="4MB"

# ESP32
CONFIG_ESP_DEFAULT_CPU_FREQ_MHZ=240 # speeed

# FreeRTOS
CONFIG_FREERTOS_HZ=1000 # for arduino-esp32
```
